## dts/bindings/behaviors/zmk,behavior-rgb-timer.yaml
```yaml
description: RGB timer control behavior

compatible: "zmk,behavior-rgb-timer"

include: one_param.yaml

properties:
  "#binding-cells":
    const: 1
```

## dts/bindings/behaviors/zmk,behavior-sleep-all.yaml
```yaml
description: Deep sleep both halves
compatible: "zmk,behavior-sleep-all"
include: zero_param.yaml
```

## dts/bindings/behaviors/zmk,behavior-sleep-source.yaml
```yaml
description: Deep sleep the source side
compatible: "zmk,behavior-sleep-source"
include: zero_param.yaml
```

## dts/bindings/behaviors/zmk,behavior-ws2812-activity-sync.yaml
```yaml
description: WS2812 split activity synchronization behavior

compatible: "zmk,behavior-ws2812-activity-sync"

include: one_param.yaml
```

## dts/bindings/behaviors/zmk,behavior-ws2812-idle-sync.yaml
```yaml
description: WS2812 idle sync

compatible: "zmk,behavior-ws2812-idle-sync"

include: one_param.yaml

properties:
  "#binding-cells":
    const: 1
```

## dts/bindings/behaviors/zmk,behavior-ws2812-layer-sync.yaml
```yaml
description: WS2812 layer sync behavior (runs on all split parts automatically)

compatible: "zmk,behavior-ws2812-layer-sync"

include: one_param.yaml
```
